@heading API reference
@itemize @bullet
@item
The @emph{GNU libmicrohttpd} manual by Marco Maggi and Christian Grothoff 2008 
@uref{http://gnunet.org/libmicrohttpd/microhttpd.html}

@item
All referenced RFCs can be found on the website of @emph{The Internet Engineering Task Force}
@uref{http://www.ietf.org/}

@item
@emph{RFC 2616}: Fielding, R., Gettys, J., Mogul, J., Frystyk, H., and T. Berners-Lee,
"Hypertext Transfer Protocol -- HTTP/1.1", RFC 2016, January 1997.

@item
@emph{RFC 2617}: Franks, J., Hallam-Baker, P., Hostetler, J., Lawrence, S., Leach, P.,
Luotonen, A., and L. Stewart, "HTTP Authentication: Basic and Digest Access Authentication", RFC 2617, June 1999.


@item 
A well--structured @emph{HTML} reference can be found on
@uref{http://www.echoecho.com/html.htm}

For those readers understanding German or French, there is an excellent document both for learning
@emph{HTML} and for reference, whose English version unfortunately has been discontinued.
@uref{http://de.selfhtml.org/} and @uref{http://fr.selfhtml.org/}


@end itemize
