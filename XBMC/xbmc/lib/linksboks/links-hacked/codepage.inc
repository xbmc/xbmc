/* Automatoticaly generated by gen-cp */

#pragma data_seg( "LBKSDATA" )
#pragma const_seg()

struct table_entry table_7bit [] = {
	{ 0, 0 }
};

unsigned char *aliases_7bit [] = {"us-ascii", "ascii", "7bit", "7-bit", "iso-ir-6", "ANSI_X3.4", "646", "it-ascii", NULL };

struct table_entry table_8859_1 [] = {
	{ 0xA0, 0x00A0 },
	{ 0xA1, 0x00A1 },
	{ 0xA2, 0x00A2 },
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	{ 0, 0 }
};

unsigned char *aliases_8859_1 [] = {"ISO8859-1", "ISO-8859-1", "8859-1", "iso-ir-100", "latin1", "l1", "819","iso-latin1", NULL };

struct table_entry table_8859_2 [] = {
	{ 0xA0, 0x00A0 },
	{ 0xA1, 0x0104 },
	{ 0xA2, 0x02D8 },
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	{ 0, 0 }
};

unsigned char *aliases_8859_2 [] = {"ISO8859-2", "ISO-8859-2", "8859-2", "iso-ir-101", "latin2", "l2","iso-latin2", "iso8859-2", NULL };

struct table_entry table_8859_3 [] = {
	{ 0x80, 0x0080 },
	{ 0x81, 0x0081 },
	{ 0x82, 0x0082 },
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	{ 0, 0 }
};

unsigned char *aliases_8859_3 [] = {"ISO8859-3", "ISO-8859-3", "8859-3", NULL };

struct table_entry table_8859_4 [] = {
	{ 0x80, 0x0080 },
	{ 0x81, 0x0081 },
	{ 0x82, 0x0082 },
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	{ 0, 0 }
};

unsigned char *aliases_8859_4 [] = {"ISO8859-4", "ISO-8859-4", "8859-4", "iso-ir-110", "latin4", "l4","iso-latin4", NULL };

struct table_entry table_8859_5 [] = {
	{ 0x80, 0x0080 },
	{ 0x81, 0x0081 },
	{ 0x82, 0x0082 },
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	{ 0, 0 }
};

unsigned char *aliases_8859_5 [] = {"ISO8859-5", "ISO-8859-5", "8859-5" , NULL };

struct table_entry table_8859_6 [] = {
	{ 0x80, 0x0080 },
	{ 0x81, 0x0081 },
	{ 0x82, 0x0082 },
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	{ 0, 0 }
};

unsigned char *aliases_8859_6 [] = {"ISO8859-6", "ISO-8859-6", "8859-6", NULL };

struct table_entry table_8859_7 [] = {
	{ 0x80, 0x0080 },
	{ 0x81, 0x0081 },
	{ 0x82, 0x0082 },
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	{ 0, 0 }
};

unsigned char *aliases_8859_7 [] = {"ISO8859-7", "ISO-8859-7", "8859-7", "iso-ir-126", "elot-928", NULL };

struct table_entry table_8859_8 [] = {
	{ 0x80, 0x0080 },
	{ 0x81, 0x0081 },
	{ 0x82, 0x0082 },
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	{ 0, 0 }
};

unsigned char *aliases_8859_8 [] = {"ISO8859-8", "ISO-8859-8", "8859-8", NULL };

struct table_entry table_8859_9 [] = {
	{ 0x80, 0x0080 },
	{ 0x81, 0x0081 },
	{ 0x82, 0x0082 },
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	{ 0, 0 }
};

unsigned char *aliases_8859_9 [] = {"ISO8859-9", "ISO-8859-9", "8859-9" , NULL };

struct table_entry table_8859_10 [] = {
	{ 0x80, 0x0080 },
	{ 0x81, 0x0081 },
	{ 0x82, 0x0082 },
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	{ 0, 0 }
};

unsigned char *aliases_8859_10 [] = {"ISO8859-10", "ISO-8859-10", "8859-10", NULL };

struct table_entry table_8859_13 [] = {
	{ 0x80, 0x0080 },
	{ 0x81, 0x0081 },
	{ 0x82, 0x0082 },
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	{ 0, 0 }
};

unsigned char *aliases_8859_13 [] = {"ISO8859-13", "ISO-8859-13", "8859-13", "iso-ir-179", "latin7", "l7","iso-latin7", NULL };

struct table_entry table_8859_14 [] = {
	{ 0x80, 0x0080 },
	{ 0x81, 0x0081 },
	{ 0x82, 0x0082 },
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	{ 0, 0 }
};

unsigned char *aliases_8859_14 [] = {"ISO8859-14", "ISO-8859-14", "8859-14", NULL };

struct table_entry table_8859_15 [] = {
	{ 0x80, 0x0080 },
	{ 0x81, 0x0081 },
	{ 0x82, 0x0082 },
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	{ 0, 0 }
};

unsigned char *aliases_8859_15 [] = {"ISO8859-16", "ISO-8859-15", "8859-15", NULL };

struct table_entry table_8859_16 [] = {
	{ 0x80, 0x0080 },
	{ 0x81, 0x0081 },
	{ 0x82, 0x0082 },
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	{ 0, 0 }
};

unsigned char *aliases_8859_16 [] = {"ISO8859-17", "ISO-8859-16", "8859-16", NULL };

struct table_entry table_cp1250 [] = {
	{ 0x80, 0x20AC },
	{ 0x81, },
	{ 0x82, 0x201A },
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	{ 0, 0 }
};

unsigned char *aliases_cp1250 [] = {"windows-1250", "1250", "cp1250", NULL };

struct table_entry table_cp1251 [] = {
	{ 0x80, 0x0402 },
	{ 0x81, 0x0403 },
	{ 0x82, 0x201A },
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	{ 0, 0 }
};

unsigned char *aliases_cp1251 [] = {"windows-1251", "1251", "cp1251", NULL };

struct table_entry table_cp1252 [] = {
	{ 0, 0 }
};

unsigned char *aliases_cp1252 [] = {"windows-1252", "1252", "cp1252", NULL };

struct table_entry table_cp1256 [] = {
	{ 0x80, 0x20AC },
	{ 0x81, 0x067E },
	{ 0x82, 0x201A },
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	{ 0, 0 }
};

unsigned char *aliases_cp1256 [] = {"windows-1256", "1256", "cp1256", NULL };

struct table_entry table_cp1257 [] = {
	{ 0x80, 0x20AC },
	{ 0x81, },
	{ 0x82, 0x201A },
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	{ 0, 0 }
};

unsigned char *aliases_cp1257 [] = {"windows-1257", "1257", "cp1257", NULL };

struct table_entry table_cp437 [] = {
	{ 0x80, 0x00c7 },
	{ 0x81, 0x00fc },
	{ 0x82, 0x00e9 },
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	{ 0, 0 }
};

unsigned char *aliases_cp437 [] = {"cp437", "437", NULL };

struct table_entry table_cp737 [] = {
	{ 0x80, 0x0391 },
	{ 0x81, 0x0392 },
	{ 0x82, 0x0393 },
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	{ 0, 0 }
};

unsigned char *aliases_cp737 [] = {"cp737", "737", NULL };

struct table_entry table_cp850 [] = {
	{ 0x80, 0x00c7 },
	{ 0x81, 0x00fc },
	{ 0x82, 0x00e9 },
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	{ 0, 0 }
};

unsigned char *aliases_cp850 [] = {"cp850", "850", NULL };

struct table_entry table_cp852 [] = {
	{ 0x80, 0x00c7 },
	{ 0x81, 0x00fc },
	{ 0x82, 0x00e9 },
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	{ 0, 0 }
};

unsigned char *aliases_cp852 [] = {"cp852", "852", NULL };

struct table_entry table_cp866 [] = {
	{ 0x80, 0x0410 },
	{ 0x81, 0x0411 },
	{ 0x82, 0x0412 },
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	{ 0, 0 }
};

unsigned char *aliases_cp866 [] = {"cp866", "866", "ibm866", NULL };

struct table_entry table_cp1125 [] = {
	{ 0x80, 0x0410 },
	{ 0x81, 0x0411 },
	{ 0x82, 0x0412 },
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	{ 0, 0 }
};

unsigned char *aliases_cp1125 [] = {"x-cp866-u", "ruscii", "1125", NULL };

struct table_entry table_macroman [] = {
	{ 0x80, 0x00C4 },
	{ 0x81, 0x00C5 },
	{ 0x82, 0x00C7 },
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	{ 0, 0 }
};

unsigned char *aliases_macroman [] = {"x-mac", "mac", "macroman", NULL };

struct table_entry table_mac_lat2 [] = {
	{ 0x80, 0x00C4 },
	{ 0x81, 0x0100 },
	{ 0x82, 0x0101 },
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	{ 0, 0 }
};

unsigned char *aliases_mac_lat2 [] = {"x-mac-ce", "mac-ce", "maclatin2", "10029", NULL };

struct table_entry table_kamen [] = {
	{ 0x80, 0x010C },
	{ 0x81, 0x00FC },
	{ 0x82, 0x00E9 },
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	{ 0, 0 }
};

unsigned char *aliases_kamen [] = {"x-kam-cs", "kam", "867", "869", NULL };

struct table_entry table_koi8_r [] = {
	{ 0x80, 0x2500 },
	{ 0x81, 0x2502 },
	{ 0x82, 0x250C },
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	{ 0, 0 }
};

unsigned char *aliases_koi8_r [] = {"koi8-r", NULL };

struct table_entry table_koi8_u [] = {
	{ 0x80, 0x2500 },
	{ 0x81, 0x2502 },
	{ 0x82, 0x250C },
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	{ 0, 0 }
};

unsigned char *aliases_koi8_u [] = {"koi8-u", NULL };

struct table_entry table_tcvn5712 [] = {
	{ 0x80, 0x00C0 },
	{ 0x81, 0x1EA2 },
	{ 0x82, 0x00C3 },
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	{ 0, 0 }
};

unsigned char *aliases_tcvn5712 [] = {"TCVN-5712", "TCVN", "TCVN-0", "TCVN-1", NULL };

struct table_entry table_viscii [] = {
	{ 0x80, 0x1EA0 },
	{ 0x81, 0x1EAE },
	{ 0x82, 0x1EB0 },
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	{ 0, 0 }
};

unsigned char *aliases_viscii [] = {"VISCII", "VISCII-1", "VISCII 1.1", "VISCII-1.1", "VISCII1.1-1", NULL };

struct table_entry table_utf_8 [] = {
	{ 0, 0 }
};

unsigned char *aliases_utf_8 [] = {"utf-8", "utf8", NULL };

struct codepage_desc codepages [] = {
	{ "7-bit ASCII", aliases_7bit, table_7bit },
	{ "ISO 8859-1", aliases_8859_1, table_8859_1 },
	{ "ISO 8859-2", aliases_8859_2, table_8859_2 },
	{ "ISO 8859-3", aliases_8859_3, table_8859_3 },
	{ "ISO 8859-4", aliases_8859_4, table_8859_4 },
	{ "ISO 8859-5", aliases_8859_5, table_8859_5 },
	{ "ISO 8859-6", aliases_8859_6, table_8859_6 },
	{ "ISO 8859-7", aliases_8859_7, table_8859_7 },
	{ "ISO 8859-8", aliases_8859_8, table_8859_8 },
	{ "ISO 8859-9", aliases_8859_9, table_8859_9 },
	{ "ISO 8859-10", aliases_8859_10, table_8859_10 },
	{ "ISO 8859-13", aliases_8859_13, table_8859_13 },
	{ "ISO 8859-14", aliases_8859_14, table_8859_14 },
	{ "ISO 8859-15", aliases_8859_15, table_8859_15 },
	{ "ISO 8859-16", aliases_8859_16, table_8859_16 },
	{ "Window$ 1250", aliases_cp1250, table_cp1250 },
	{ "Window$ 1251", aliases_cp1251, table_cp1251 },
	{ "Window$ 1252", aliases_cp1252, table_cp1252 },
	{ "Window$ 1256", aliases_cp1256, table_cp1256 },
	{ "Window$ 1257", aliases_cp1257, table_cp1257 },
	{ "CP 437", aliases_cp437, table_cp437 },
	{ "CP 737", aliases_cp737, table_cp737 },
	{ "CP 850", aliases_cp850, table_cp850 },
	{ "CP 852", aliases_cp852, table_cp852 },
	{ "CP 866", aliases_cp866, table_cp866 },
	{ "CP 1125 (Ukrainian)", aliases_cp1125, table_cp1125 },
	{ "MacRoman 2000", aliases_macroman, table_macroman },
	{ "Mac latin 2", aliases_mac_lat2, table_mac_lat2 },
	{ "Kamenicky Brothers", aliases_kamen, table_kamen },
	{ "KOI8-R", aliases_koi8_r, table_koi8_r },
	{ "KOI8-U", aliases_koi8_u, table_koi8_u },
	{ "TCVN-5712", aliases_tcvn5712, table_tcvn5712 },
	{ "VISCII", aliases_viscii, table_viscii },
	{ "Unicode UTF-8", aliases_utf_8, table_utf_8 },
	{ NULL, NULL, NULL }
};

#pragma data_seg( "LBKS_RW" )
#pragma const_seg( "LBKS_RD" )
